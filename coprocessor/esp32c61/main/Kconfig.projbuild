## coprocessor/esp32c61/main/Kconfig.projbuild
```kconfig
menu "WT99P461-S1 companion diagnostics"
    config WT_C61_ALLOC_TRACE
        bool "Record failed allocator caller sites"
        default n
        help
            Diagnostic builds only. Record up to eight failed call sites using
            bounded, allocation-free wrappers and the IDF 5.5.5 Wi-Fi OS adapter.
            Does not change allocation results or reset failure counters.
endmenu
```

## coprocessor/esp32c61/sdkconfig.defaults
```kconfig
CONFIG_IDF_TARGET="esp32c61"
CONFIG_ESP_HOSTED=y
CONFIG_ESP_HOSTED_CP=y
CONFIG_ESP_HOSTED_CP_FOR_MCU=y
CONFIG_ESP_HOSTED_CP_RPC_V2=y
CONFIG_ESP_HOSTED_CP_FEAT_WIFI=y
CONFIG_ESP_HOSTED_CP_FEAT_PEER_DATA=y
CONFIG_EH_TRANSPORT_CP_SPI=y
CONFIG_EH_TRANSPORT_CP_SPI_MODE_3=y
CONFIG_EH_TRANSPORT_CP_SPI_CONTROLLER_HSPI=y
CONFIG_EH_TRANSPORT_CP_SPI_HSPI_GPIO_MOSI=27
CONFIG_EH_TRANSPORT_CP_SPI_HSPI_GPIO_MISO=28
CONFIG_EH_TRANSPORT_CP_SPI_HSPI_GPIO_CLK=26
CONFIG_EH_TRANSPORT_CP_SPI_HSPI_GPIO_CS=25
CONFIG_EH_TRANSPORT_CP_SPI_GPIO_HANDSHAKE=22
CONFIG_EH_TRANSPORT_CP_SPI_GPIO_DATA_READY=23
CONFIG_ESPTOOLPY_FLASHSIZE_4MB=y
CONFIG_PARTITION_TABLE_TWO_OTA_LARGE=y
CONFIG_FREERTOS_HZ=1000
CONFIG_ESP_WIFI_NVS_ENABLED=y
CONFIG_PM_SLEEP_FUNC_IN_IRAM=y
# Keep WLAN code in Flash to leave room for measured RX burst peaks.
# CONFIG_ESP_WIFI_IRAM_OPT is not set
# CONFIG_ESP_WIFI_RX_IRAM_OPT is not set
# CONFIG_ESP_WIFI_SLP_IRAM_OPT is not set
# CONFIG_ESP_WIFI_ENTERPRISE_SUPPORT is not set
# CONFIG_BT_ENABLED is not set
```
